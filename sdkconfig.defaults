## sdkconfig.defaults
```kconfig
# ESP32C3 specific defaults
CONFIG_IDF_TARGET="esp32c3"
CONFIG_IDF_TARGET_ESP32C3=y

# Disable Bluetooth completely
CONFIG_BT_ENABLED=n

# Increase log verbosity for debugging
CONFIG_LOG_DEFAULT_LEVEL_INFO=y
CONFIG_LOG_DEFAULT_LEVEL=3
CONFIG_BOOTLOADER_LOG_LEVEL_INFO=y
CONFIG_BOOTLOADER_LOG_LEVEL=3


# ESP32C3 specific optimizations
CONFIG_COMPILER_OPTIMIZATION_SIZE=y
CONFIG_BOOTLOADER_COMPILER_OPTIMIZATION_SIZE=y

# WiFi resilience settings (applies to both ESP-LR and normal modes)
CONFIG_ESP_WIFI_STA_BEACON_TIMEOUT=10
CONFIG_ESP_WIFI_AUTH_WPA2_PSK=y
CONFIG_ESP_WIFI_AUTH_WPA3_PSK=y
CONFIG_ESP_WIFI_ENABLE_WPA3_SAE=y

# Increase WiFi buffers for stability (both modes)
CONFIG_ESP_WIFI_STATIC_RX_BUFFER_NUM=10
CONFIG_ESP_WIFI_DYNAMIC_RX_BUFFER_NUM=32
CONFIG_ESP_WIFI_TX_BUFFER_TYPE=DYNAMIC
CONFIG_ESP_WIFI_DYNAMIC_TX_BUFFER_NUM=32

# WiFi AMPDU settings (only affects normal mode, ESP-LR ignores these)
CONFIG_ESP_WIFI_AMPDU_TX_ENABLED=y
CONFIG_ESP_WIFI_AMPDU_RX_ENABLED=y

# Connection parameters (only affects normal mode)
CONFIG_ESP_WIFI_11B_SUPPORT=y
CONFIG_ESP_WIFI_SOFTAP_SUPPORT=n

CONFIG_HTTPD_MAX_REQ_HDR_LEN=512

# Just these proven settings
CONFIG_LWIP_MAX_SOCKETS=10
CONFIG_HTTPD_MAX_OPEN_SOCKETS=10
CONFIG_HTTPD_PURGE_BUF_LEN=32

# Disable WiFi power save for stable LR performance
CONFIG_ESP_WIFI_PS_NONE=y

# Flash settings for 4MB
CONFIG_ESPTOOLPY_FLASHSIZE_4MB=y
CONFIG_ESPTOOLPY_FLASHSIZE="4MB"
CONFIG_PARTITION_TABLE_CUSTOM=y
CONFIG_PARTITION_TABLE_CUSTOM_FILENAME="partitions_c3.csv"

CONFIG_LWIP_TCP_WND_DEFAULT=65535
CONFIG_LWIP_TCP_SND_BUF_DEFAULT=65535
CONFIG_LWIP_TCP_RECVMBOX_SIZE=64

# =============================================================================
# Brownout Detection Configuration
# =============================================================================
# DISABLED: Hardware BMS cuts power at ~3.0V, making ESP32's 2.4V brownout
# detector redundant. Application-level battery protection (3.4-3.6V) provides
# proper power management before reaching BMS cutoff.
#
# With BMS protection:
# - Application checks battery at 3.6V (turn off nRF52)
# - Application checks battery at 3.4V (critical, immediate sleep)
# - BMS cuts power at 3.0V (hardware protection)
# - ESP32 brownout at 2.4V never reached (disabled)
CONFIG_ESP_BROWNOUT_DET=n
```
